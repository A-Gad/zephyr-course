## Kconfig
```
menuconfig LED_SUBSYSTEM
    bool "LED Subsystem"
    default y

if LED_SUBSYSTEM

choice LED_BLINK_SPEED
    prompt "led blink speed"
    default BLINK_SLEEP_1000MS

config BLINK_SLEEP_250MS
    bool "fast (250ms)"

config BLINK_SLEEP_1000MS
    bool "normal (1s)"

config BLINK_SLEEP_2000MS
    bool "slow (2s)"
endchoice

config LED_BLINK_SLEEP_TIME
    int 
    default 250  if BLINK_SLEEP_250MS
    default 1000 if BLINK_SLEEP_1000MS
    default 2000 if BLINK_SLEEP_2000MS

endif 

menuconfig ADVANCED_LED_SETTINGS
    bool "Advanced led settings"
    default n

if ADVANCED_LED_SETTINGS
    config LED_BRIGHTNESS
    int "LED brightness (0-100)"
        default 100
        range 0 100

    config LED_FADE_DURATION_MS
    int "LED fade duration (ms)"
        default 500
endif

menu "Exper settings"
visible if ADVANCED_LED_SETTINGS

config ENABLE_LED_DEBUGGING
bool "enable LED debugging"
    default n

config CUSTOM_BLINK_PATTERN
bool "custom blink pattern"
    default n
endmenu

source "Kconfig.zephyr"
```

## prj.conf
```kconfig
CONFIG_GPIO=y
CONFIG_LOG=y
CONFIG_BLINK_SLEEP_250MS=y
CONFIG_ADVANCED_LED_SETTINGS=y
CONFIG_ENABLE_LED_DEBUGGING=n
CONFIG_CUSTOM_BLINK_PATTERN=n
CONFIG_LED_BRIGHTNESS=80
CONFIG_LED_FADE_DURATION_MS=250
```

## src/main.cpp
```c
#include <zephyr/drivers/gpio.h>
#include <zephyr/kernel.h>
#include <zephyr/logging/log.h>



/* The devicetree node identifier for the "led0" alias. */
#define LED_NODE DT_ALIAS(led0)

static const struct gpio_dt_spec led = GPIO_DT_SPEC_GET(LED_NODE, gpios);

LOG_MODULE_REGISTER(main, LOG_LEVEL_INF);

int main(void)
{
    bool led_state = true;

    if (!gpio_is_ready_dt(&led)) return 0;

    if (gpio_pin_configure_dt(&led, GPIO_OUTPUT_ACTIVE) < 0) return 0;

    while (1) {
        if (gpio_pin_toggle_dt(&led) < 0) return 0;

        led_state = !led_state;
        LOG_INF("LED state: %s", led_state ? "ON" : "OFF");
        k_msleep(CONFIG_LED_BLINK_SLEEP_TIME);
    }
    return 0;
}
```
